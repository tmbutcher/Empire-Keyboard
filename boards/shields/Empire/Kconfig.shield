## config/west.yml
```yaml
manifest:
  
  defaults:
    revision: main
  
  remotes:
    - name: zmkfirmware
      url-base: https://github.com/zmkfirmware
  
  projects:
    - name: zmk
      remote: zmkfirmware
      revision: v0.3
      import: app/west.yml

  self:
    path: config
```
